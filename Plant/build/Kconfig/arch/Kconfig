## Plant/build/Kconfig/arch/Kconfig
```kconfig
# Load Zephyr Arch Kconfig descriptions.
osource "/home/cl0us/zephyr/zephyr/arch/rx/Kconfig"
osource "/home/cl0us/zephyr/zephyr/arch/x86/Kconfig"
osource "/home/cl0us/zephyr/zephyr/arch/xtensa/Kconfig"
osource "/home/cl0us/zephyr/zephyr/arch/sparc/Kconfig"
osource "/home/cl0us/zephyr/zephyr/arch/riscv/Kconfig"
osource "/home/cl0us/zephyr/zephyr/arch/posix/Kconfig"
osource "/home/cl0us/zephyr/zephyr/arch/mips/Kconfig"
osource "/home/cl0us/zephyr/zephyr/arch/arm64/Kconfig"
osource "/home/cl0us/zephyr/zephyr/arch/arm/Kconfig"
osource "/home/cl0us/zephyr/zephyr/arch/arc/Kconfig"
```

## Plant/build/Kconfig/boards/Kconfig.nucleo_wl55jc
```kconfig
# Load board Kconfig descriptions.
osource "/home/cl0us/zephyr/zephyr/boards/st/nucleo_wl55jc/Kconfig.nucleo_wl55jc"
```

## zephyr_LoRaWAN/build/Kconfig/boards/Kconfig
```kconfig
# Load Zephyr board Kconfig descriptions.
osource "/home/cl0us/zephyr/zephyr/boards/st/nucleo_wl55jc/Kconfig"
```

## zephyr_LoRaWAN/build/Kconfig/boards/Kconfig.defconfig
```kconfig
# Load Zephyr board defconfig descriptions.
osource "/home/cl0us/zephyr/zephyr/boards/st/nucleo_wl55jc/Kconfig.defconfig"
```
