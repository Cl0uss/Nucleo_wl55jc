## CMakeLists.txt
```
# ==========================
# CMake configuration
# ==========================
cmake_minimum_required(VERSION 3.20.0)

# Найти Zephyr SDK (важно!)
find_package(Zephyr REQUIRED HINTS $ENV{ZEPHYR_BASE})

project(final_project)

# ==========================
# Папки с исходниками
# ==========================
# Добавляем заголовки
target_include_directories(app PRIVATE
    ${CMAKE_CURRENT_SOURCE_DIR}/headers
)

# Добавляем исходники сенсоров и main.c
target_sources(app PRIVATE
    src/main.c
    sensors/accelerometerSensor.c
    sensors/brightnessSensor.c
    sensors/earthSensor.c
    sensors/gpsSensor.c
    sensors/rgbSensor.c
    sensors/temperatureSensor.c
)
```

## prj.conf
```kconfig
# --- UART / Serial ---
CONFIG_SERIAL=y
CONFIG_UART_INTERRUPT_DRIVEN=y
CONFIG_UART_CONSOLE=y
CONFIG_STDOUT_CONSOLE=y
CONFIG_PRINTK=y
CONFIG_UART_STM32=y

# --- Power management ---
CONFIG_PM_DEVICE=y

# --- Sensors ---
CONFIG_ADC=y
CONFIG_I2C=y

# --- Float / printf ---
CONFIG_NEWLIB_LIBC=y
CONFIG_NEWLIB_LIBC_FLOAT_PRINTF=y

# --- Stack sizes ---
CONFIG_MAIN_STACK_SIZE=4096
CONFIG_SYSTEM_WORKQUEUE_STACK_SIZE=2048
CONFIG_IDLE_STACK_SIZE=512

# --- Thread diagnostics / safety ---
CONFIG_THREAD_STACK_INFO=y
CONFIG_STACK_SENTINEL=y
CONFIG_ASSERT=y

# --- FPU ---
CONFIG_FPU=y

# --- Logging (опционально) ---
CONFIG_LOG=y
CONFIG_LOG_PRINTK=y
CONFIG_LOG_MODE_IMMEDIATE=y
```

## boards/nucleo_wl55jc.overlay
```dts
&usart1 {
    status = "okay";
    current-speed = <9600>;
    pinctrl-0 = <&usart1_tx_pb6 &usart1_rx_pb7>;
    pinctrl-names = "default";
};
```

## src/main.c
```c
#include "connector.h"
#include "rgbSensor.h"

enum Mode {TEST, NORMAL, ADVANCED};
enum Mode mode = TEST;

const struct device *i2c;

void bufferChanger(uint8_t *buff, uint8_t first, uint8_t second) {
    buff[0] = first;
    buff[1] = second;
}

void rgbInit() {
    uint8_t buff[2];

    bufferChanger(buff, rgbCommandBit | rgbEnable, rgbEnablePon);
    i2c_write(i2c,buff,sizeof(buff),rgbAddr);
    
    k_msleep(3);
    bufferChanger(buff, rgbCommandBit | rgbEnable, rgbEnableAen | rgbEnablePon);
    i2c_write(i2c,buff,sizeof(buff),rgbAddr);

    bufferChanger(buff, rgbCommandBit | rgbAtime, 0xD5);
    i2c_write(i2c,buff,sizeof(buff),rgbAddr);

    bufferChanger(buff, rgbCommandBit | rgbControl, 0x00);
    i2c_write(i2c,buff,sizeof(buff),rgbAddr);

    bufferChanger(buff, rgbCommandBit | rgbWaitTime, rgbWaitValue);
    i2c_write(i2c, buff, sizeof(buff), rgbAddr);
}


static void i2cSensors(void) {
    accelerometerSensor();
}

static void analogSensors(void) {
    brightnessSensor();
}




K_THREAD_DEFINE(uartThread,   1024, gpsSensor,     NULL, NULL, NULL, 1, 0, 0);
K_THREAD_DEFINE(i2cThread,    4096, i2cSensors,    NULL, NULL, NULL, 1, 0, 0);
K_THREAD_DEFINE(analogThread, 1024, analogSensors, NULL, NULL, NULL, 1, 0, 0);


void main(void) {
    k_thread_suspend(uartThread);
    k_thread_suspend(i2cThread);
    k_thread_suspend(analogThread);
 
    while (mode == TEST) {
        k_thread_resume(i2cThread);
        k_msleep(2000);
    }
}
```
