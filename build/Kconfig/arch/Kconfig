## build/Kconfig/arch/Kconfig
```kconfig
# Load Zephyr Arch Kconfig descriptions.
osource "/home/cl0us/zephyrproject/zephyr/arch/rx/Kconfig"
osource "/home/cl0us/zephyrproject/zephyr/arch/x86/Kconfig"
osource "/home/cl0us/zephyrproject/zephyr/arch/xtensa/Kconfig"
osource "/home/cl0us/zephyrproject/zephyr/arch/sparc/Kconfig"
osource "/home/cl0us/zephyrproject/zephyr/arch/riscv/Kconfig"
osource "/home/cl0us/zephyrproject/zephyr/arch/posix/Kconfig"
osource "/home/cl0us/zephyrproject/zephyr/arch/mips/Kconfig"
osource "/home/cl0us/zephyrproject/zephyr/arch/arm64/Kconfig"
osource "/home/cl0us/zephyrproject/zephyr/arch/arm/Kconfig"
osource "/home/cl0us/zephyrproject/zephyr/arch/arc/Kconfig"
```

## build/Kconfig/boards/Kconfig.defconfig
```kconfig
# Load Zephyr board defconfig descriptions.
osource "/home/cl0us/zephyrproject/zephyr/boards/st/nucleo_wl55jc/Kconfig.defconfig"
```

## build/Kconfig/boards/Kconfig.sysbuild
```kconfig
# Load Sysbuild board Kconfig descriptions.
osource "/home/cl0us/zephyrproject/zephyr/boards/st/nucleo_wl55jc/Kconfig.sysbuild"
```

## final_project/build/Kconfig/boards/Kconfig.nucleo_wl55jc
```kconfig
# Load board Kconfig descriptions.
osource "/home/cl0us/zephyrproject/zephyr/boards/st/nucleo_wl55jc/Kconfig.nucleo_wl55jc"
```
